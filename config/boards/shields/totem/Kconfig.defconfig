## config/boards/shields/totem/Kconfig.defconfig
```kconfig
# Copyright (c) 2020 The ZMK Contributors
# SPDX-License-Identifier: MIT

if SHIELD_TOTEM_CENTRAL_SNAKE

if ZMK_BACKLIGHT

config PWM
    default y

config LED_PWM
    default y

endif # ZMK_BACKLIGHT

config ZMK_KEYBOARD_NAME
    default "TOTEMX LP"

config ZMK_SPLIT_ROLE_CENTRAL
    default y

choice ZMK_DISPLAY_STATUS_SCREEN
    default ZMK_DISPLAY_STATUS_SCREEN_CUSTOM
endchoice

config ZMK_DISPLAY_STATUS_SCREEN_CUSTOM
    select ZMK_WPM
    imply ZMK_HID_INDICATORS

choice ZMK_DISPLAY_WORK_QUEUE
    default ZMK_DISPLAY_WORK_QUEUE_DEDICATED
endchoice

config LV_Z_VDB_SIZE
	default 64
    
config LV_DPI_DEF
    default 148

config LV_Z_BITS_PER_PIXEL
    default 16

choice ST7789V_PIXEL_FORMAT
    default ST7789V_RGB565
endchoice

choice LV_COLOR_DEPTH
    default LV_COLOR_DEPTH_16
endchoice

endif

if SHIELD_TOTEM_CENTRAL_PROSPECTOR

if ZMK_BACKLIGHT

config PWM
    default y

config LED_PWM
    default y

endif # ZMK_BACKLIGHT

config ZMK_KEYBOARD_NAME
    default "TOTEMX LP"
    
config ZMK_SPLIT_ROLE_CENTRAL
    default y

config ZMK_USB
    default y

endif

if SHIELD_TOTEM_CENTRAL_DONGLE || SHIELD_TOTEM_CENTRAL_LEFT || SHIELD_TOTEM_ESP32_DONGLE

config ZMK_KEYBOARD_NAME
    default "TOTEMX LP"

config ZMK_SPLIT_ROLE_CENTRAL
    default y

endif

if ZMK_DISPLAY

config SSD1306
    default y

choice ZMK_DISPLAY_WORK_QUEUE
    default ZMK_DISPLAY_WORK_QUEUE_DEDICATED
endchoice

endif

if LVGL

config LV_Z_VDB_SIZE
    default 64

config LV_DPI_DEF
    default 148

config LV_Z_BITS_PER_PIXEL
    default 1

choice LV_COLOR_DEPTH
    default LV_COLOR_DEPTH_1
endchoice

endif

if SHIELD_TOTEM_CENTRAL_DONGLE || SHIELD_TOTEM_CENTRAL_LEFT || SHIELD_TOTEM_PERIPHERAL_LEFT || SHIELD_TOTEM_PERIPHERAL_RIGHT || SHIELD_TOTEM_CENTRAL_SNAKE || SHIELD_TOTEM_CENTRAL_PROSPECTOR || SHIELD_TOTEM_ESP32_DONGLE

config ZMK_SPLIT
    default y

config ZMK_BLE
    default y

config ZMK_POINTING
    default y

endif

if SHIELD_TOTEM_CENTRAL_LEFT || SHIELD_TOTEM_PERIPHERAL_LEFT

config I2C
    default y

endif
```

## config/boards/shields/totem/Kconfig.shield
```kconfig
# Copyright (c) 2020 The ZMK Contributors
# SPDX-License-Identifier: MIT

config SHIELD_TOTEM_CENTRAL_DONGLE
	def_bool $(shields_list_contains,totem_central_dongle)

config SHIELD_TOTEM_ESP32_DONGLE
	def_bool $(shields_list_contains,totem_esp32_dongle)

config SHIELD_TOTEM_CENTRAL_SNAKE
    def_bool $(shields_list_contains,totem_central_snake)

config SHIELD_TOTEM_CENTRAL_LEFT
    def_bool $(shields_list_contains,totem_central_left)

config SHIELD_TOTEM_PERIPHERAL_LEFT
    def_bool $(shields_list_contains,totem_peripheral_left)

config SHIELD_TOTEM_PERIPHERAL_RIGHT
    def_bool $(shields_list_contains,totem_peripheral_right)

config SHIELD_TOTEM_CENTRAL_PROSPECTOR
    def_bool $(shields_list_contains,totem_central_prospector)
```

## config/west.yml
```yaml
manifest:
  remotes:
    - name: zmkfirmware
      url-base: https://github.com/zmkfirmware
    - name: carrefinho                           
      url-base: https://github.com/carrefinho   
    - name: felixJR123
      url-base: https://github.com/felixJR123
  projects:
    - name: zmk
      remote: zmkfirmware
      revision: main
      import: app/west.yml
    - name: prospector-zmk-module               
      remote: carrefinho                         
      revision: feat/new-status-screens          
    - name: snake-dongle-modified
      remote: felixJR123
      revision: zephyr-4.1
    - name: zmk-esp32-dongle
      remote: felixJR123
      revision: main
  self:
    path: config
    
```
